## Projeto_drone_m2/main/Kconfig.projbuild
```kconfig
menu "Drone experiment"
config DRONE_EXPERIMENT
    string "Experiment identifier (letters, digits, underscore or hyphen)"
    default "default"
choice DRONE_PROTOCOL
    prompt "Experiment protocol"
    default DRONE_PROTOCOL_UDP
config DRONE_PROTOCOL_UDP
    bool "UDP"
config DRONE_PROTOCOL_TCP
    bool "TCP"
endchoice
config DRONE_TOUCH_THRESHOLD_PERCENT
    int "Touch threshold change (%)"
    range 1 90
    default 20
    help
        Initial threshold; calibrate with the actual electrodes, untouched at boot.
        Increase if idle noise triggers events; decrease if real touches are missed.
endmenu
```

## Projeto_drone_m2/sdkconfig.defaults
```kconfig
CONFIG_FREERTOS_HZ=1000

CONFIG_FREERTOS_GENERATE_RUN_TIME_STATS=y

CONFIG_FREERTOS_RUN_TIME_STATS_USING_ESP_TIMER=y

CONFIG_ESP_TRACE_LIB_EXTERNAL=y
CONFIG_DRONE_TOUCH_THRESHOLD_PERCENT=20
CONFIG_ESP_MAIN_TASK_STACK_SIZE=8192
```
